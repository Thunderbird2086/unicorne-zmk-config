## boards/shields/unicorne/Kconfig.shield
```kconfig
# Copyright (c) 2023 The ZMK Contributors
# SPDX-License-Identifier: MIT

config SHIELD_UNICORNE
    bool

config SHIELD_UNICORNE_3X5_LEFT
    def_bool $(shields_list_contains,unicorne_3x5_left)
    select SHIELD_UNICORNE

config SHIELD_UNICORNE_3X5_RIGHT
    def_bool $(shields_list_contains,unicorne_3x5_right)
    select SHIELD_UNICORNE

config SHIELD_UNICORNE_3X6_LEFT
    def_bool $(shields_list_contains,unicorne_3x6_left)
    select SHIELD_UNICORNE

config SHIELD_UNICORNE_3X6_RIGHT
    def_bool $(shields_list_contains,unicorne_3x6_right)
    select SHIELD_UNICORNE
```

## boards/shields/unicorne_3x6/Kconfig.shield
```kconfig
config SHIELD_UNICORNE_3X6_LEFT
    def_bool $(shields_list_contains,unicorne_3x6_left)

config SHIELD_UNICORNE_3X6_RIGHT
    def_bool $(shields_list_contains,unicorne_3x6_right)
```

## config/boards/shields/unicorne_3x5/Kconfig.shield
```kconfig
config SHIELD_UNICORNE_3X5_LEFT
    def_bool $(shields_list_contains,unicorne_3x5_left)

config SHIELD_UNICORNE_3X5_RIGHT
    def_bool $(shields_list_contains,unicorne_3x5_right)
```
